## yocto/meta-embedded-power-gateway/conf/layer.conf
```bitbake
# We have a conf and classes directory, add to BBPATH
BBPATH .= ":${LAYERDIR}"

# We have recipes-* directories, add to BBFILES
BBFILES += "${LAYERDIR}/recipes-*/*/*.bb \
            ${LAYERDIR}/recipes-*/*/*.bbappend"

BBFILE_COLLECTIONS += "meta-embedded-power-gateway"
BBFILE_PATTERN_meta-embedded-power-gateway = "^${LAYERDIR}/"
BBFILE_PRIORITY_meta-embedded-power-gateway = "6"

LAYERDEPENDS_meta-embedded-power-gateway = "core"
LAYERSERIES_COMPAT_meta-embedded-power-gateway = "kirkstone"
```
